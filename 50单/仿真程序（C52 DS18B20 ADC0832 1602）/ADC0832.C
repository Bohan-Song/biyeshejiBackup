#include<head.h>

unsigned char CH1=0x00;
unsigned char CH2=0x01;

//******************adc0832****************************//
//通道的选择:0x02就是单通道0；0x03就是单通道1；
//0x00就是双通道ch0=“+”；   ch0=“-”
//0x01就是双通道ch0=“-”；   ch0=“+”
//*****************************************************//
unsigned char ADconv(unsigned char CH)
{
	unsigned char  i=0 , x =0 , y = 0 ;
	unsigned char temp;
	AD0832_CLK = 0 ;         //时钟置低平
	AD0832_DI  = 1 ;         //开始信号为高电平
	AD0832_CS  = 0 ;         //片选信号置低，启动AD转换芯片
	//输入开始信号（构成一个正脉冲） 
	_nop_();
	AD0832_CLK = 1 ;         //时钟上升沿，输入开始信号
	_nop_();
	AD0832_CLK = 0 ;         //时钟下降沿
	//模拟信号输入模式选择（1：单模信号，0：双模差分信号）
	AD0832_DI  = 1 ; 
	 _nop_();
	AD0832_CLK = 1 ;         //时钟上升沿，输入开始信号
	_nop_();
	AD0832_CLK = 0 ;         //时钟下降沿
	//模拟信号输入通道选择（1：通道CH1，0：通道CH0）
	AD0832_DI  = CH ;          //选择通道0
	 _nop_();
	AD0832_CLK = 1 ;         //时钟上升沿，输入开始信号
	_nop_();
	AD0832_CLK = 0 ;         //时钟下降沿
//=================================================================	
	AD0832_DI  = 1 ;     //数据线置高，准备接收数据
	for(i = 0 ; i<8 ; i++)	 //从高位移入数据
	 {
	    AD0832_CLK = 1 ;      
	       _nop_();
	    AD0832_CLK = 0 ;             //时钟下降沿,AD0832输出数据，高位（MSB）先
	       x = x<<1;				//数据左移位，补0
	  if(AD0832_DO ==1) 
	     x = x | 0x01;	           //如果数据为"1"，移入1，
	 }     				          //如果数据为"0"，移入0，
	
	for(i = 0 ; i<8 ; i++)	     //从低位移入数据
	{  
	       y = y>>1;			//数据左移位，补0
	   if(AD0832_DO ==1) 
	       y = y | 0x80;	    //如果数据为"1"，移入1，
	  							//如果数据为"0"，移入0
	   AD0832_CLK = 1 ;      
	    _nop_();
	   AD0832_CLK = 0 ;         //时钟下降沿,AD0832输出数据，高位（MSB）先
	 }
	 //数据线置高，释放总线，完成一次转换
	  AD0832_CLK = 1 ;        
	  AD0832_DI  = 1 ;         
	  AD0832_CS  = 1 ;  

	  if(x==y)     //输出
	  {
	     temp = x;  
	  }

	return temp; //返回最终值
}